## sdkconfig.defaults.esp32
```kconfig
CONFIG_ESPTOOLPY_FLASHSIZE_4MB=y
CONFIG_PARTITION_TABLE_CUSTOM=y
CONFIG_PARTITION_TABLE_CUSTOM_FILENAME="partitions.csv"
CONFIG_PARTITION_TABLE_FILENAME="partitions.csv"
CONFIG_EXAMPLE_DEPLOY_WEB_PAGES=y
CONFIG_EXAMPLE_WEB_MOUNT_POINT="/www"
CONFIG_ESP_MAIN_TASK_STACK_SIZE=8192
```
